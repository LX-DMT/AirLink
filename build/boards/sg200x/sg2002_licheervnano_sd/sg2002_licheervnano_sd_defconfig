## build/boards/sg200x/sg2002_licheervnano_sd/sg2002_licheervnano_sd_defconfig
```kconfig
CONFIG_CHIP_sg2002=y
CONFIG_BOARD_licheervnano_sd=y
CONFIG_DDR_CFG_ddr3_1866_x16=y
CONFIG_ARCH="riscv"
CONFIG_CROSS_COMPILE="riscv64-unknown-linux-musl-"
CONFIG_CC_OPTIMIZE_FOR_SIZE=y
CONFIG_KERNEL_ENTRY_HACK=y
CONFIG_KERNEL_ENTRY_HACK_ADDR="0x80200000"
CONFIG_TOOLCHAIN_MUSL_RISCV64=y
CONFIG_FLASH_SIZE_SHRINK=y
CONFIG_BOOT_IMAGE_SINGLE_DTB=y
CONFIG_CP_EXT_WIRELESS=y
CONFIG_STORAGE_TYPE_sd=y
CONFIG_MIPI_PANEL_ZCT2133V1 is not set
CONFIG_UBOOT_2021_10=y
CONFIG_KERNEL_SRC_5.10=y
CONFIG_KERNEL_UNCOMPRESSED=y
# CONFIG_SKIP_RAMDISK is not set
# 禁用传感器相关配置
# CONFIG_SENSOR_GCORE_GC4653 is not set
# CONFIG_SENSOR_OV_OV2685 is not set
# CONFIG_SENSOR_OV_OS04A10 is not set
# CONFIG_SENSOR_LONTIUM_LT6911 is not set
# CONFIG_SENSOR_SMS_SC035GS is not set
# CONFIG_SENSOR_SMS_SC500AI is not set
# CONFIG_SENSOR_TUNING_PARAM_cv181x_src_gcore_gc4653 is not set

# CONFIG_SENSOR_TUNING_PARAM_sg200x_src_ov_os04a10=y
# CONFIG_ROOTFS_OVERLAYFS is not set
# CONFIG_ENABLE_FREERTOS=y
# CONFIG_TARGET_PACKAGE_GATORD is not set
# CONFIG_TARGET_PACKAGE_BT is not set
```
